## layers/meta-st-develop/meta-st-stm32mp/conf/machine/include/tune-aarch32.inc
```bitbake
DEFAULTTUNE ?= "aarch32"

require conf/machine/include/arm/armv8a/tune-cortexa35.inc

TUNE_PKGARCH_32 = "${ARMPKGARCH}${ARMPKGSFX_THUMB}${ARMPKGSFX_EABI}${ARMPKGSFX_FPU}"

TUNEVALID[aarch32] = "Enable instructions for ARMv8-a"
TUNECONFLICTS[aarch32] = "armv4 armv5 armv6 armv7 armv7a"

MACHINEOVERRIDES =. "${@bb.utils.contains('TUNE_FEATURES', 'aarch32', 'aarch32:', '', d)}"

#TUNE_CCARGS .= "${@bb.utils.contains('TUNE_FEATURES', 'aarch32', ' -march=armv8-a -mcpu=cortex-a35', '', d)}"
TUNE_CCARGS .= "${@bb.utils.contains('TUNE_FEATURES', 'aarch32', ' -mcpu=cortex-a35 ', '', d)}"
# CPR: we would like to have: -mcpu=cortex-a35 -mfpu=neon-fp-armv8


TUNEVALID[fp-armv8] = "Enable ARMv8 Vector Floating Point unit."
TUNE_CCARGS_MFPU .= "${@bb.utils.contains('TUNE_FEATURES', 'fp-armv8', ' fp-armv8', '', d)}"
TUNE_CCARGS_MFPU .= "${@bb.utils.contains('TUNE_FEATURES', [ 'fp-armv8', 'neon' ], ' neon-fp-armv8', '', d)}"

# Little Endian base configs
AVAILTUNES += "aarch32 aarch32t"
ARMPKGARCH:tune-aarch32                    ?= "aarch32"
ARMPKGARCH:tune-aarch32t                   ?= "aarch32"
TUNE_FEATURES:tune-aarch32                  = "arm aarch32 neon fp-armv8 callconvention-hard"
#TUNE_FEATURES:tune-aarch32t                 = "${TUNE_FEATURES:tune-aarch32} thumb"
#PACKAGE_EXTRA_ARCHS:tune-aarch32            = "aarch32hf-neon-fp-armv8"
#PACKAGE_EXTRA_ARCHS:tune-aarch32t           = "${PACKAGE_EXTRA_ARCHS:tune-aarch32} aarch32t2hf-neon-fp-armv8"
PACKAGE_EXTRA_ARCHS:tune-aarch32            = "aarch32hf-neon-fp-armv8"
#PACKAGE_EXTRA_ARCHS:tune-aarch32t           = "${PACKAGE_EXTRA_ARCHS:tune-aarch32} aarch32thf-neon-fp-armv8"

BASE_LIB:tune-aarch32                       = "lib"
BASE_LIB:tune-aarch32t                      = "lib"

#TUNEVALID[cortexa35-a32] = "Enable Cortex-A35 specific processor optimizations"

#AVAILTUNES += "cortexa35_32 cortexa35_32t"
#ARMPKGARCH:tune-cortexa35_32      ?= "cortexa35"
#ARMPKGARCH:tune-cortexa35_32t     ?= "cortexa35"
#TUNE_FEATURES:tune-cortexa35_32   = "${TUNE_FEATURES:tune-aarch32} cortexa35"
#TUNE_FEATURES:tune-cortexa35_32t  = "${TUNE_FEATURES:tune-aarch32t} cortexa35"

#PACKAGE_EXTRA_ARCHS:tune-cortex35_32  = "${PACKAGE_EXTRA_ARCHS:tune-aarch32} cortexa35hf-neon-fp-armv8"
#PACKAGE_EXTRA_ARCHS:tune-cortex35_32t = "${PACKAGE_EXTRA_ARCHS:tune-cortexa35_32} cortexa35t2hf-neon-fp-armv8"
#PACKAGE_EXTRA_ARCHS:tune-cortex35_32  = "${PACKAGE_EXTRA_ARCHS:tune-aarch32} cortexa35 cortexa35hf-neon cortexa35hf-neon-fp-armv8"
#PACKAGE_EXTRA_ARCHS:tune-cortex35_32t = "${PACKAGE_EXTRA_ARCHS:tune-cortexa35_32} cortexa35hf-neon-fp-armv8"

#BASE_LIB:tune-cortexa35-32  = "lib"
#BASE_LIB:tune-cortexa35-32t = "lib"
```

## layers/meta-st/meta-st-stm32mp/conf/machine/stm32mp2-m33td.conf
```bitbake
#@TYPE: Machine
#@NAME: stm32mp2-m33td
#@DESCRIPTION: Configuration for STM32MP2x boards for cm33tdcid
#@NEEDED_BSPLAYERS: layers/meta-openembedded/meta-oe layers/meta-openembedded/meta-python

# Define specific familly common machine name
MACHINEOVERRIDES =. "stm32mp2m33tdcommon:stm32mp2m33td:"
MACHINEOVERRIDES =. "stm32mp2common:stm32mp25common:stm32mp23common:stm32mp21common:"

include conf/machine/include/st-machine-common-stm32mp.inc
include conf/machine/include/st-machine-providers-stm32mp.inc

# =========================================================================
# Chip architecture
# =========================================================================
DEFAULTTUNE = "cortexa35"
include conf/machine/include/arm/armv8a/tune-cortexa35.inc

# =========================================================================
# boot scheme
# =========================================================================
BOOTSCHEME_LABELS = "optee"

# =========================================================================
# boot device
# =========================================================================
# Define the boot device supported
BOOTDEVICE_LABELS += "nor-sdcard"
BOOTDEVICE_LABELS += "nor-nor-sdcard"
BOOTDEVICE_LABELS += "nor-emmc"
BOOTDEVICE_LABELS += "emmc"
BOOTDEVICE_LABELS += "sdcard"

# =========================================================================
# Machine settings
# =========================================================================
# Define list of devicetree per supported storage
# NOR configured with only master boot partitions
EXTERNAL_DEVICETREE_NOR_mb = "stm32mp257f-ev1-cm33tdcid-ostl"
# NOR configured with only master and secondary boot partitions
EXTERNAL_DEVICETREE_NOR_mb_sb = "stm32mp257f-ev1-cm33tdcid-ostl"
EXTERNAL_DEVICETREE_SDCARD =  "stm32mp257f-ev1-cm33tdcid-ostl"
EXTERNAL_DEVICETREE_SDCARD =+ "stm32mp215f-dk-cm33tdcid-ostl"
EXTERNAL_DEVICETREE_EMMC = "stm32mp257f-ev1-cm33tdcid-ostl"

STM32MP_DT_FILES_PROGRAMMER = ""
EXTERNAL_DEVICETREE_PROGRAMMER =  "stm32mp257f-ev1-cm33tdcid-ostl-serial-ca35tdcid"
EXTERNAL_DEVICETREE_PROGRAMMER =+ "stm32mp215f-dk-cm33tdcid-ostl-serial-ca35tdcid"

STM32MP_DEVICETREE_PROGRAMMER_ENABLE = "1"
STM32MP_DEVICETREE_PROGRAMMER_SUFFIX = "-serial-ca35tdcid"

# =========================================================================
# Machine features
# =========================================================================
MACHINE_FEATURES += "splashscreen"
MACHINE_FEATURES += "watchdog"
MACHINE_FEATURES += "bluetooth"
MACHINE_FEATURES += "wifi"

# GPU
MACHINE_FEATURES += "${@'gpu' if d.getVar('ACCEPT_EULA_'+d.getVar('MACHINE')) == '1' else ''}"
MACHINE_FEATURES += "${@'openvx' if d.getVar('ACCEPT_EULA_'+d.getVar('MACHINE')) == '1' else ''}"
MACHINE_FEATURES += "${@'opencl' if d.getVar('ACCEPT_EULA_'+d.getVar('MACHINE')) == '1' else ''}"
MACHINE_FEATURES += "${@'vulkan' if d.getVar('ACCEPT_EULA_'+d.getVar('MACHINE')) == '1' else ''}"

# M33
MACHINE_FEATURES += "m33copro"

# M33TD
MACHINE_FEATURES += "m33td"

# Bluetooth
BLUETOOTH_LIST += "linux-firmware-addons-bcm43xx"
# Wifi
WIFI_LIST += "linux-firmware-addons-bcm43xx"
# PCIe
PCI_LIST += "linux-firmware-rtl8168"

# Configure external dt suffix
EXTDT_USE_SUFFIX = "1"
EXTDT_SUFFIX_EMMC   = "-emmc"
EXTDT_SUFFIX_NOR    = "-snor"
EXTDT_SUFFIX_SDCARD = "-sdcard"

# ==========================================================================
# M33 Boards
# ==========================================================================
# Lists of boards/devicetree on which the m33 service MUST be started
M33_BOARDS_START_AT_STARTUP = "stm32mp257f-ev1"
M33_BOARDS_START_AT_STARTUP =+ "stm32mp215f-dk"
M33_BOARDS_START_AT_STARTUP =+ "${@bb.utils.contains('EXTERNAL_DT_ENABLED', '1', 'stm32mp215f-dk-ca35tdcid-ostl', '', d)}"
M33_BOARDS_START_AT_STARTUP =+ "${@bb.utils.contains('EXTERNAL_DT_ENABLED', '1', 'stm32mp257f-ev1-ca35tdcid-ostl', '', d)}"

# M33 Ns fiwmware (firwmare use on M33 with TF-M for secure part and Cube firmware for none-secure)
# List of configuration by cube project with match TF-M profile
M33TD_FIRMWARE_CONFIG = "stm32mp257f_ev1"
M33TD_FIRMWARE_CONFIG += "stm32mp215f_dk"

# Cube project associated to each cube project
M33TD_FIRMWARE_PROJECT[stm32mp257f_ev1] = "Projects/STM32MP257F-EV1/Demonstrations/StarterApp_M33TD"
M33TD_FIRMWARE_PROJECT[stm32mp215f_dk] = "Projects/STM32MP215F-DK/Demonstrations/StarterApp_M33TD"

# =========================================================================
# OPTEE
# =========================================================================
# For sdk generation, declare the default board configuration to use.
ST_OPTEE_EXPORT_TA_REF_BOARD:stm32mp2common = "stm32mp257f-dk.dts"
```
